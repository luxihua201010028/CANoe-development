VERSION ""

NS_ :

BS_:

BU_: Display Door Engine
VAL_TABLE_ VtEnv_Door_Status 3 "BothDoorOpen" 2 "RightDoorOpen" 1 "LeftDoorOpen" 0 "BothDoorClose" ;

BO_ 512 DoorState: 1 Door
 SG_ Door_R : 2|1@1+ (1,0) [0|1] ""  Display
 SG_ Door_L : 0|1@1+ (1,0) [0|1] ""  Display

BO_ 336 EngineState: 2 Engine
 SG_ OnOff : 15|1@1+ (1,0) [0|1] ""  Door,Display
 SG_ EngineSpeed : 0|15@1- (1,0) [0|5500] "r.p.m."  Door,Display

EV_ EnvDoorState: 0 [0|3] "" 0 1 DUMMY_NODE_VECTOR0 Vector__XXX;

BA_DEF_ BU_  "NodeLayerModules" STRING ;
BA_DEF_ SG_  "NWM-WakeupAllowed" ENUM  "No","Yes";
BA_DEF_ BO_  "GenMsgILSupport" ENUM  "No","Yes";
BA_DEF_ BU_  "NmStationAddress" INT 0 63;
BA_DEF_  "NmBaseAddress" HEX 1024 1087;
BA_DEF_  "BusType" STRING ;
BA_DEF_ BO_  "GenMsgCycleTime" INT 0 50000;
BA_DEF_ BO_  "GenMsgSendType" ENUM  "Cyclic","NotUsed","NotUsed","NotUsed","NotUsed","NotUsed","NotUsed","IfActive","NoMsgSendType","NotUsed","vector_leerstring";
BA_DEF_ SG_  "GenSigSendType" ENUM  "Cyclic","OnWrite","OnWriteWithRepetition","OnChange","OnChangeWithRepetition","IfActive","IfActiveWithRepetition","NoSigSendType","NotUsed","NotUsed","NotUsed","NotUsed","NotUsed";
BA_DEF_DEF_  "NodeLayerModules" "CANoeILNLVector.dll";
BA_DEF_DEF_  "NWM-WakeupAllowed" "Yes";
BA_DEF_DEF_  "GenMsgILSupport" "Yes";
BA_DEF_DEF_  "NmStationAddress" 0;
BA_DEF_DEF_  "NmBaseAddress" 1024;
BA_DEF_DEF_  "BusType" "";
BA_DEF_DEF_  "GenMsgCycleTime" 0;
BA_DEF_DEF_  "GenMsgSendType" "NoMsgSendType";
BA_DEF_DEF_  "GenSigSendType" "Cyclic";
BA_ "BusType" "CAN";
BA_ "NmStationAddress" BU_ Display 3;
BA_ "NmStationAddress" BU_ Door 2;
BA_ "NmStationAddress" BU_ Engine 1;
BA_ "GenMsgSendType" BO_ 512 0;
BA_ "GenMsgCycleTime" BO_ 512 200;
BA_ "GenMsgSendType" BO_ 336 0;
BA_ "GenMsgCycleTime" BO_ 336 100;
VAL_ 512 Door_R 1 "Open" 0 "Close" ;
VAL_ 512 Door_L 1 "Open" 0 "Close" ;
VAL_ 336 OnOff 1 "On" 0 "Off" ;
VAL_ EnvDoorState 3 "BothDoorOpen" 2 "RightDoorOpen" 1 "LeftDoorOpen" 0 "BothDoorClose" ;
