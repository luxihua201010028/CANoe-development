/*@!Encoding:1252*/
includes
{
  //To add the head files
}

variables
{
  enum ESession {DefaultSession, ExtendedSession, ProductionSession};
  enum ESecurityLevel {Lock, Unlock_1, Unlock_2};
  int CURRENT_SESSION;
  int CURRENT_SECURITY_LEVEL;
  byte SESSION_TIMING_P2[2] = {0x00, 0x96};
  byte SESSION_TIMING_PX[2] = {0x00, 0xC8};
  byte MANUFACTURING_DATE[3] = {18, 10, 18};
  byte SERIAL_NUMBER[9] = {0x31, 0x32, 0x33, 0x34, 0x35, 0x36, 0x37, 0x38, 0x39};
  byte VEHICLE_IDENTIFICATION_NUMBER[17] = {0x61, 0x62, 0x63, 0x64, 0x65, 0x66, 0x67, 0x68, 0x31, 0x32, 0x33, 0x34, 0x35, 0x36, 0x37, 0x38, 0x39};
  byte Speedbuffer[2],EngTempbuffer[1];
  byte SECURITY_SEED[4];
  byte SECURITY_KEY[4]; 
  byte SECURITY_KEY_RECEIVED[4];
  double countrycode=0,vehicletype=3,beltwarning=0,overspeedwarning=0;
  int busflag=0; //current bus status: 0 - Deactivate CANoe IL ; 1 - Activate CANoe IL 
  //To add the variables
}


///////////////////////////////////////////////////////Function/////////////////////////////////////////////////////////
on preStart
{
  ILControlInit(); //Initialize CANoe IL 
  ILControlStop(); //Deactivate CANoe IL 
}

on start
{
  CURRENT_SESSION=DefaultSession;
}

on signal_update LockStatus
{
  if(this!=busflag)
  {
    if(this==1)
    {
      ILControlStart();  //Activate CANoe IL    
    }
    else if(this==0)
    {
      ILControlStop();  //Deactivate CANoe IL      
    }
    busflag=this;
  }
}


on signal_update Gear
{
  @Cluster::Gear_Status= this;   //To display current Gear status in panel
}
///////////////////////////////////////////////////////Function/////////////////////////////////////////////////////////

//////////////////////////////////////////////////////Diagnosis/////////////////////////////////////////////////////////

//////////////////////////////////////////////////////Session///////////////////////////////////////////////////////////
on diagRequest IPC.DefaultSession_Start
{
  //Set parameter and response for default session request
  diagResponse this resp;
  resp.SetParameterRaw("P2",SESSION_TIMING_P2,elCount(SESSION_TIMING_P2));
  resp.SetParameterRaw("P2Ex",SESSION_TIMING_PX,elCount(SESSION_TIMING_PX));
  CURRENT_SESSION=DefaultSession;
  CURRENT_SECURITY_LEVEL=Lock;
  @Diagnosis::Security_Level=0;
  @Diagnosis::Session=0;
  resp.SendPositiveResponse(); 
}

on diagRequest IPC.ExtendedDiagnosticSession_Start
{
  //Set parameter and response for extended session request
  diagResponse this resp;
  resp.SetParameterRaw("P2",SESSION_TIMING_P2,elCount(SESSION_TIMING_P2));
  resp.SetParameterRaw("P2Ex",SESSION_TIMING_PX,elCount(SESSION_TIMING_PX));
  CURRENT_SESSION=ExtendedSession;
  @Diagnosis::Session=1;
  resp.SendPositiveResponse(); 
}

on diagRequest IPC.Production_Session_Start
{
  //Set parameter and response for production session request
  diagResponse this resp;
  //Judge the positive request condition
  if(CURRENT_SESSION==ExtendedSession)
  {
    resp.SetParameterRaw("P2",SESSION_TIMING_P2,elCount(SESSION_TIMING_P2));
    resp.SetParameterRaw("P2Ex",SESSION_TIMING_PX,elCount(SESSION_TIMING_PX));
    CURRENT_SESSION=ProductionSession;
    @Diagnosis::Session=2;
    @Diagnosis::Security_Level=0;
    CURRENT_SECURITY_LEVEL=Lock;
    resp.SendPositiveResponse();    
  }
  else
    resp.SendNegativeResponse(0x7E);  

}
//////////////////////////////////////////////////////Session///////////////////////////////////////////////////////////

/////////////////////////////////////////Manufacture Date Read/Write////////////////////////////////////
on diagRequest IPC.ECU_Manufacturing_Date_Read
{
  //Set parameter and response for ECU_Manufacturing_Date_Read request
  diagResponse this resp;
  //Judge the positive request condition
  if(@Diagnosis::Manufacture_Date_NRC==1)
  {
    resp.SendNegativeResponse(0x22);
  }
  else
  {
    resp.SetParameter("Manufacturing_date_Year",MANUFACTURING_DATE[0]);
    resp.SetParameter("Manufacturing_date_Month",MANUFACTURING_DATE[1]);
    resp.SetParameter("Manufacturing_date_Day",MANUFACTURING_DATE[2]);
    resp.SendPositiveResponse();
  }
}

on diagRequest IPC.ECU_Manufacturing_Date_Write
{
  //Judge the positive request condition for ECU_Manufacturing_Date_Write request
  diagResponse this resp;
  if(CURRENT_SECURITY_LEVEL==Unlock_1)
  {
     resp.SendPositiveResponse(); 
  }
  else
    resp.SendNegativeResponse(0x33);
}
/////////////////////////////////////////Manufacture Date Read/Write////////////////////////////////////

////////////////////////////////////////Serial Number Read/Write///////////////////////////////////////
on diagRequest IPC.ECU_Serial_Number_Read
{
  //Set parameter and response for ECU_Serial_Number_Read request
  diagResponse this resp;
  if(@Diagnosis::Serial_Number_NRC)
  {
    resp.SendNegativeResponse(0x22);
  }
  else
  {
    resp.SetParameterRaw("Serial_Number",SERIAL_NUMBER,elCount(SERIAL_NUMBER));
    resp.SendPositiveResponse(); 
  }   

}

on diagRequest IPC.ECU_Serial_Number_Write
{
  diagResponse this resp;
  if(CURRENT_SECURITY_LEVEL==Unlock_1)
  {
    this.GetParameterRaw("Serial_Number",SERIAL_NUMBER,elCount(SERIAL_NUMBER));
    resp.sendPositiveResponse();    
  }
  else
    resp.SendNegativeResponse(0x33);
}
////////////////////////////////////////Serial Number Read/Write///////////////////////////////////////

///////////////////////////////////ECU Identification Number Read/Write////////////////////////////////
on diagRequest IPC.Vehicle_Identification_Number_Read
{
  //Set parameter and response for Vehicle_Identification_Number_Read request
  diagResponse this resp;
  if(CURRENT_SECURITY_LEVEL==Unlock_1)
  {
    if(@Diagnosis::Identification_Number_NRC)
    {
      resp.SendNegativeResponse(0x22);
    }
    else
    {
      resp.SetParameterRaw("VIN",VEHICLE_IDENTIFICATION_NUMBER,elCount(VEHICLE_IDENTIFICATION_NUMBER));
      resp.SendPositiveResponse();   
    }
  }
  else
    resp.SendNegativeResponse(0x33);
}

on diagRequest IPC.Vehicle_Identification_Number_Write
{
  diagResponse this resp;
  if(CURRENT_SECURITY_LEVEL==Unlock_2)
  {
    this.GetParameterRaw("VIN",VEHICLE_IDENTIFICATION_NUMBER,elCount(VEHICLE_IDENTIFICATION_NUMBER));
    resp.sendPositiveResponse();
  }
  else
    resp.SendNegativeResponse(0x33);
}
///////////////////////////////////ECU Identification Number Read/Write////////////////////////////////

//////////////////////////////////////Variant Coding Read/Write////////////////////////////////////////
on diagRequest IPC.Variant_Coding_Read
{
  //Set parameter and response for Variant_Coding_Read request
  diagResponse this resp;
  if(@Diagnosis::Variant_Coding_NRC)
  {
    resp.SendNegativeResponse(0x22); 
  }
  else
  {
    resp.SetParameter("Coding_String.Country_Code",countrycode);
    resp.SetParameter("Coding_String.Vehicle_Type",vehicletype);
    resp.SetParameter("Coding_String.Belt_Warning",beltwarning);
    resp.SetParameter("Coding_String.OverSpeed_Warning",overspeedwarning);
    resp.sendPositiveResponse(); 
  }
}

on diagRequest IPC.Variant_Coding_Write
{
  diagResponse this resp;
  if(CURRENT_SECURITY_LEVEL==Unlock_1)
  {
    countrycode=this.GetParameter("Coding_String.Country_Code");
    vehicletype=this.GetParameter("Coding_String.Vehicle_Type");
    beltwarning=this.GetParameter("Coding_String.Belt_Warning");
    overspeedwarning=this.GetParameter("Coding_String.OverSpeed_Warning");
    resp.sendPositiveResponse();    
  }
  else
    resp.SendNegativeResponse(0x33);

}
//////////////////////////////////////Variant Coding Read/Write////////////////////////////////////////

//////////////////////////////////////////////////DID//////////////////////////////////////////////////
on message EngineData
{
  EngTempbuffer[0]=this.byte(0)*2;
  Speedbuffer[1]=this.byte(2);
  Speedbuffer[0]=this.byte(3);
}

on diagRequest IPC.DID_Engine_Speed_Read
{
  //Set parameter and response for DID_Engine_Speed_Read request
  diagResponse this resp;
  resp.SetParameterRaw("DID_Engine_Speed",Speedbuffer,elcount(Speedbuffer));
  resp.SendPositiveResponse();
}

on diagRequest IPC.DID_Engine_Temperature_Read
{
  //Set parameter and response for DID_Engine_Temperature_Read request
  diagResponse this resp;
  resp.SetParameterRaw("DID_Engine_Temperature",EngTempbuffer,elcount(EngTempbuffer));
  resp.SendPositiveResponse();  
}

on diagRequest IPC.Power_Supply_Voltage_Read
{
  //Set parameter and response for Power_Supply_Voltage_Read request
  diagResponse this resp;
  resp.SetParameter("DataRecord",@Diagnosis::Power_Supply_Voltage);
  resp.SendPositiveResponse();  
}
//////////////////////////////////////////////////DID//////////////////////////////////////////////////

/////////////////////////////////////////////Active Session////////////////////////////////////////////
on diagRequest IPC.Active_Diagnostic_Session_Read
{
  //Set parameter and response for Active_Diagnostic_Session_Read request
  diagResponse this resp;
  switch (CURRENT_SESSION)
  {
    case DefaultSession:
    {
      resp.SetParameter("Diagnostic_Session_Type",0x01);
      break;
    }
    case ExtendedSession:
    {
      resp.SetParameter("Diagnostic_Session_Type",0x03);
      break;
    }
    case ProductionSession:
    {
      resp.SetParameter("Diagnostic_Session_Type",0x02);
      break;
    }
  }
  resp.SendPositiveResponse();
}
/////////////////////////////////////////////Active Session////////////////////////////////////////////

//////////////////////////////////////////////Security/////////////////////////////////////////////////
on diagRequest IPC.SeedLevel1_Request
{
  //Generate level1 security key and send response
  diagResponse this resp;
  if(CURRENT_SESSION==ExtendedSession)
  {
    
    Seed_Generation();
    KeyLevel1_Calculate();
    resp.SetParameterRaw("SecuritySeed",SECURITY_SEED,elcount(SECURITY_SEED));
    resp.SendPositiveResponse();     
  }
  else 
    resp.SendNegativeResponse(0x7E);//Sub function not supported in current session
}

on diagRequest IPC.KeyLevel1_Send
{
  //Varify the level1 security key 
  diagResponse this resp;
  this.GetParameterRaw("SecurityKey",SECURITY_KEY_RECEIVED,elCount(SECURITY_KEY_RECEIVED));
  if(KEY_VERIFY()==1)
  {
    resp.SendPositiveResponse();
    CURRENT_SECURITY_LEVEL=Unlock_1;
    @Diagnosis::Security_Level=1;
  }
  else
    resp.SendNegativeResponse(0x35);//Invalid key
}

on diagRequest IPC.Seed_Level_2_Request
{
  //Generate level2 security key and send response
  diagResponse this resp;
  if(CURRENT_SECURITY_LEVEL==Unlock_1)
  {
    Seed_Generation();
    KeyLevel2_Calculate();
    resp.SetParameterRaw("SecuritySeed",SECURITY_SEED,elcount(SECURITY_SEED));
    resp.SendPositiveResponse();     
  }
  else
    resp.SendNegativeResponse(0x33);//Security access denied

}

on diagRequest IPC.Key_Level_2_Send
{
  //Varify the level2 security key 
  diagResponse this resp;
  this.GetParameterRaw("SecurityKey",SECURITY_KEY_RECEIVED,elCount(SECURITY_KEY_RECEIVED));
  if(KEY_VERIFY()==1)
  {
    resp.SendPositiveResponse();
    CURRENT_SECURITY_LEVEL=Unlock_2;
    @Diagnosis::Security_Level=2;
  }
  else
    resp.SendNegativeResponse(0x35);  
}

void Seed_Generation()
{
  //Generate seed
  int i;
  byte temp;
  for(i = 0; i < 4; i++)
  {
    temp = (int)random(250);
    SECURITY_SEED[i] = temp;
    SECURITY_KEY[i] = temp;
  }
}

void KeyLevel1_Calculate()
{
  //Calculate the key for security leve1 1
  byte temp;
  temp = SECURITY_KEY[0];
  SECURITY_KEY[0] = SECURITY_KEY[1];
  SECURITY_KEY[1] = temp;
}

void KeyLevel2_Calculate()
{
  //Calculate the key for security leve1 1
  byte temp;
  temp = SECURITY_KEY[1];
  SECURITY_KEY[1] = SECURITY_KEY[2];
  SECURITY_KEY[2] = temp;
}

int KEY_VERIFY()
{
  //Verify the security key;
  int i;
  for (i = 0; i < 4; i++)
  {
    if(SECURITY_KEY[i] != SECURITY_KEY_RECEIVED[i])
      return -1;
  }
  return 1;
}
//////////////////////////////////////////////Security/////////////////////////////////////////////////

/////////////////////////////////////////////Conmmunication Control////////////////////////////////////
on diagRequest IPC.EnableRxAndDisableTx_Control
{
  //Send negative response for EnableRxAndDisableTx_Control request
  diagResponse this resp;
  resp.SendNegativeResponse(0x12);  
}

on diagRequest IPC.EnableRxAndEnableTx_Control
{
  //Send negative response for EnableRxAndEnableTx_Control request
  diagResponse this resp;
  resp.SendNegativeResponse(0x12);  
}
/////////////////////////////////////////////Conmmunication Control////////////////////////////////////

//////////////////////////////////////////////////Hard Reset///////////////////////////////////////////
on diagRequest IPC.HardReset_Reset
{
  //Send negative response for HardReset_Reset request
  diagResponse this resp;
  resp.SendNegativeResponse(0x12);  
}

//////////////////////////////////////////////////Hard Reset///////////////////////////////////////////

//////////////////////////////////////////////////////Diagnosis/////////////////////////////////////////////////////////